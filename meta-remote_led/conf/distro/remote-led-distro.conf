## meta-remote_led/conf/distro/remote-led-distro.conf
```bitbake
DISTRO_FEATURES:remove = "bluetooth zeroconf opengl wayland vulcan avahi alsa pulseaudio x11"
MACHINE_FEATURES:remove = "alsa bluetooth vc4graphics"
# req'd for some raspberry pi drivers
LICENSE_FLAGS_ACCEPTED = "synaptics-killswitch"
```

## meta-remote_led/conf/layer.conf
```bitbake
# We have a conf and classes directory, add to BBPATH
BBPATH .= ":${LAYERDIR}"

# We have recipes-* directories, add to BBFILES
BBFILES += "${LAYERDIR}/recipes-*/*/*.bb \
            ${LAYERDIR}/recipes-*/*/*.bbappend"

BBFILE_COLLECTIONS += "meta-remote_led"
BBFILE_PATTERN_meta-remote_led = "^${LAYERDIR}/"
BBFILE_PRIORITY_meta-remote_led = "6"

LAYERDEPENDS_meta-remote_led = "core"
LAYERSERIES_COMPAT_meta-remote_led = "scarthgap"

DISTRO_NAME = "remote-led-distro"
DISTRO_VERSION = "1"
```
